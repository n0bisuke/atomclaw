## main/Kconfig.projbuild
```kconfig
menu "Build Variant"

    choice DEVICE_VARIANT
        prompt "Device variant"
        default DEVICE_MIMICLAW
        help
            Select which firmware variant to build.

        config DEVICE_MIMICLAW
            bool "MimiClaw (16MB Flash, Telegram + WebSocket)"

        config DEVICE_ATOMCLAW
            bool "AtomClaw (8MB Flash, Discord + Cloudflare)"

    endchoice

endmenu
```

## sdkconfig.defaults.wifi_diag
```kconfig
# WiFi diagnostics firmware (minimal app)
CONFIG_IDF_TARGET="esp32s3"

# Flash settings for common S3 boards
CONFIG_ESPTOOLPY_FLASHSIZE_8MB=y
CONFIG_ESPTOOLPY_FLASHSIZE="8MB"
CONFIG_ESPTOOLPY_FLASHMODE_QIO=y
CONFIG_ESPTOOLPY_FLASHFREQ_80M=y

# Console over USB Serial/JTAG
CONFIG_ESP_CONSOLE_USB_SERIAL_JTAG=y
CONFIG_ESP_CONSOLE_SECONDARY_NONE=y

# Keep this firmware PSRAM-independent
CONFIG_SPIRAM=n

# Reduce noise while keeping WiFi diagnostics visible
CONFIG_LOG_DEFAULT_LEVEL_INFO=y
```
